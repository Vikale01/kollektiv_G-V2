/*
oled_display.c

Created: 2025-12-03
Author: Viktor, Nicklas

*/

/*
  Oled_DrawPixel(0,0,0x0F); // Längst upp i vänstra hörnet
  Oled_DrawPixel(127,0,0x0F); // Längst upp i högra hörnet
  Oled_DrawPixel(0,127,0x0F); // Längst ned i vänstra hörnet
  Oled_DrawPixel(127,127,0x0F); // Längst ned i högra hörnet
*/

#include "oled_display.h"

static uint8_t buffer[128*128/2];  // 8192 bytes
volatile bool display_busy = 0;

#define DIGIT_W  12
#define DIGIT_H  20

const uint8_t* digits[10] = {digit_0, digit_1, digit_2, digit_3, digit_4, digit_5, digit_6, digit_7, digit_8, digit_9};

const uint8_t icon_gps_20x20[] =
{
    0x06, 0x00, 0x00,
    0x07, 0x00, 0x00,
    0x07, 0x80, 0x00,
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    0x07, 0x00, 0x00,
};

const uint8_t icon_bt_20x20[] =
{
    0x00, 0x60, 0x00, 0x00, 0x78, 0x00, 0x00, 0x7C, 0x00, 0x00, 0x6E, 0x00,
    0x00, 0x67, 0x80, 0x1C, 0x63, 0x80, 0x1E, 0x67, 0x80, 0x07, 0xFE, 0x00,
    0x03, 0xFC, 0x00, 0x01, 0xF0, 0x00, 0x00, 0xF0, 0x00, 0x03, 0xFC, 0x00,
    0x07, 0xFE, 0x00, 0x0E, 0x67, 0x80, 0x1C, 0x63, 0x80, 0x00, 0x67, 0x80,
    0x00, 0x6E, 0x00, 0x00, 0x7C, 0x00, 0x00, 0x78, 0x00, 0x00, 0x60, 0x00,
};

const uint8_t digit_0[40] = { 
    0x0F, 0x00, 0x1F, 0x80, 0x30, 0xC0, 0x60, 0x60,  
    0x60, 0x60, 0xC0, 0x30, 0xC0, 0x30, 0xC0, 0x30,  
    0xC0, 0x30, 0xC0, 0x30, 0xC0, 0x30, 0xC0, 0x30,  
    0xC0, 0x30, 0xC0, 0x30, 0x60, 0x60, 0x60, 0x60,  
    0x30, 0xC0, 0x1F, 0x80, 0x0F, 0x00, 0x0F, 0x00,  
}; 

const uint8_t digit_1[40] = { 
    0x03, 0x00, 0x0F, 0x00, 0x1F, 0x00, 0x36, 0x00,  
    0x03, 0x00, 0x03, 0x00, 0x03, 0x00, 0x03, 0x00,  
    0x03, 0x00, 0x03, 0x00, 0x03, 0x00, 0x03, 0x00,  
    0x03, 0x00, 0x03, 0x00, 0x03, 0x00, 0x03, 0x00,  
    0x03, 0x00, 0x3F, 0xC0, 0x3F, 0xC0, 0x3F, 0xC0,  
}; 

const uint8_t digit_2[40] = { 
    0x1F, 0x00, 0x3F, 0x80, 0x61, 0xC0, 0xC0, 0xC0,  
    0x00, 0xC0, 0x00, 0xC0, 0x01, 0x80, 0x03, 0x00,  
    0x06, 0x00, 0x0C, 0x00, 0x18, 0x00, 0x30, 0x00,  
    0x60, 0x00, 0x60, 0x00, 0x60, 0x00, 0x60, 0x00,  
    0x60, 0x00, 0x60, 0x00, 0x7F, 0xC0, 0x7F, 0xC0,  
}; 

const uint8_t digit_3[40] = { 
    0x1F, 0x00, 0x3F, 0x80, 0x61, 0xC0, 0xC0, 0xC0,  
    0x00, 0xC0, 0x00, 0xC0, 0x01, 0x80, 0x1F, 0x00,  
    0x1F, 0x80, 0x00, 0xC0, 0x00, 0x60, 0x00, 0x60,  
    0x00, 0x60, 0x00, 0x60, 0xC0, 0xC0, 0xE1, 0xC0,  
    0x7F, 0x80, 0x3F, 0x00, 0x1F, 0x00, 0x1F, 0x00,  
}; 

const uint8_t digit_4[40] = { 
    0x03, 0x00, 0x07, 0x00, 0x0F, 0x00, 0x1B, 0x00,  
    0x33, 0x00, 0x63, 0x00, 0xC3, 0x00, 0xC3, 0x00,  
    0xC3, 0x00, 0xC3, 0x00, 0xFF, 0xC0, 0xFF, 0xC0,  
    0x03, 0x00, 0x03, 0x00, 0x03, 0x00, 0x03, 0x00,  
    0x03, 0x00, 0x03, 0x00, 0x03, 0x00, 0x03, 0x00,  
}; 

const uint8_t digit_5[40] = { 
    0x7F, 0x80, 0x7F, 0x80, 0x60, 0x00, 0x60, 0x00,  
    0x60, 0x00, 0x60, 0x00, 0x7E, 0x00, 0x7F, 0x00,  
    0x63, 0x80, 0x03, 0x80, 0x01, 0x80, 0x01, 0x80,  
    0x01, 0x80, 0x01, 0x80, 0xC1, 0x80, 0xE3, 0x80,  
    0x7F, 0x00, 0x3E, 0x00, 0x3E, 0x00,  
}; 

const uint8_t digit_6[40] = { 
    0x1F, 0x00, 0x3F, 0x00, 0x70, 0xC0, 0x60, 0x00,  
    0xC0, 0x00, 0xC0, 0x00, 0xDF, 0x00, 0xFF, 0x80,  
    0xF1, 0x80, 0xE1, 0x80, 0xC1, 0x80, 0xC1, 0x80,  
    0xC1, 0x80, 0xC1, 0x80, 0xC1, 0x80, 0xE1, 0x80,  
    0xF3, 0x80, 0x7F, 0x00, 0x3E, 0x00, 0x3E, 0x00,  
}; 

const uint8_t digit_7[40] = { 
    0x7F, 0xE0, 0x7F, 0xE0, 0x00, 0x60, 0x00, 0xC0,  
    0x01, 0x80, 0x01, 0x80, 0x03, 0x00, 0x03, 0x00,  
    0x06, 0x00, 0x06, 0x00, 0x0C, 0x00, 0x0C, 0x00,  
    0x18, 0x00, 0x18, 0x00, 0x30, 0x00, 0x30, 0x00,  
    0x30, 0x00, 0x30, 0x00, 0x30, 0x00, 0x30, 0x00,  
};  

const uint8_t digit_8[40] = { 
    0x1F, 0x00, 0x3F, 0x80, 0x60, 0xC0, 0x60, 0xC0,  
    0x60, 0xC0, 0x60, 0xC0, 0x60, 0xC0, 0x3F, 0x80,  
    0x3F, 0x80, 0x60, 0xC0, 0x60, 0xC0, 0x60, 0xC0,  
    0x60, 0xC0, 0x60, 0xC0, 0x60, 0xC0, 0x60, 0xC0,  
    0x60, 0xC0, 0x3F, 0x80, 0x1F, 0x00, 0x1F, 0x00,  
}; 
  

const uint8_t digit_9[40] = { 
    0x1F, 0x00, 0x3F, 0x80, 0x60, 0xC0, 0x60, 0xC0,  
    0xC0, 0xC0, 0xC0, 0xC0, 0xC0, 0xC0, 0xC0, 0xC0,  
    0xC0, 0xC0, 0xC0, 0xC0, 0x61, 0xC0, 0x7F, 0xC0,  
    0x3F, 0x80, 0x00, 0xC0, 0x00, 0xC0, 0x01, 0x80,  
    0x01, 0x80, 0x03, 0x00, 0x7F, 0x00, 0x3E, 0x00,  
}; 
 

const uint8_t Afry_logo[] = {
    0x00, 0x00, 0x00, 0x00, 0x00, 0x00, 0x00, 0x00, 0x00, 0x00, 0x00, 0x00, 0x00, 0x00, 0x00, 0x00,
    0x00, 0x00, 0x00, 0x00, 0x00, 0x00, 0x00, 0x7F, 0xFE, 0x00, 0x00, 0x00, 0x00, 0x00, 0x00, 0x00,
    0x00, 0x00, 0x00, 0x00, 0x00, 0x00, 0x3F, 0xFF, 0xFF, 0xF8, 0x00, 0x00, 0x00, 0x00, 0x00, 0x00,
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    0x00, 0x00, 0x00, 0x00, 0x00, 0x00, 0x00, 0x3F, 0xFC, 0x00, 0x00, 0x00, 0x00, 0x00, 0x00, 0x00
};

const uint8_t KG_logo[] = {
    0x00, 0x00, 0x00, 0x00, 0x00, 0x00, 0x00, 0x00, 0x00, 0x00, 0x00, 0x00, 0x00, 0x00, 0x00, 0x00,
    0x00, 0x00, 0x00, 0x00, 0x00, 0x00, 0x00, 0x7F, 0xFE, 0x00, 0x00, 0x00, 0x00, 0x00, 0x00, 0x00,
    0x00, 0x00, 0x00, 0x00, 0x00, 0x00, 0x3F, 0xFF, 0xFF, 0xF8, 0x00, 0x00, 0x00, 0x00, 0x00, 0x00,
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    0x00, 0x00, 0x00, 0x00, 0x00, 0x00, 0x00, 0x3F, 0xFC, 0x00, 0x00, 0x00, 0x00, 0x00, 0x00, 0x00

};
void Oled_SendCommand(uint8_t com)
{
    if(HAL_I2C_Mem_Write(&hi2c1, SSD1327_I2C_ADRESS, 0x00, 1, &com, 1, HAL_MAX_DELAY) != HAL_OK)
    {
        return;
    } 
}

void Oled_SendData(uint8_t data)
{
    HAL_I2C_Mem_Write(&hi2c1, SSD1327_I2C_ADRESS, 0x40, 1, &data, 1, HAL_MAX_DELAY);    
}

void Oled_init(void) // Kan användas ifall default-inställnigarna inte är bra
{
    Oled_SendCommand(DISPLAY_OFF);              // Stänger av Display innan init.

    Oled_SendCommand(SET_MUX_RATIO); 
    Oled_SendCommand(0x7F);                     // Ställer multiplex ratio - 127 -> 128 rader (128x128)
    
    Oled_SendCommand(SET_DISPLAY_STARTLINE);
    Oled_SendCommand(0x00);                     // Anger startlinje för displayen. 0 = första raden

    Oled_SendCommand(SET_DISPLAY_OFFSET);
    Oled_SendCommand(0x00);                     // Vertikal offset. 0 = ingen förskjutning.

    Oled_SendCommand(SET_DISPLAY_REMAP);
    Oled_SendCommand(0x51);                     // 0x51 = Column remap enabled, Horizontal increment, COM remap enabled

    Oled_SendCommand(SET_CONTRAST_C);
    Oled_SendCommand(0x7F);                     // Ställer kontrastnivå (0-255)

    Oled_SendCommand(SET_PHASE_LENGTH);
    Oled_SendCommand(0x22);                     // Ställer Phase1 = 2, Phase2 = 2 DCLK. Påverkar hur länge pixlar pre-charges innan de lyser.
    
    Oled_SendCommand(SET_FRONT_CLOCK);
    Oled_SendCommand(0x50);                     // Ställer front clock divider / oscillator frequency. 0x50 = standard. Påverkar uppdateringsfrekvens

    Oled_SendCommand(SET_DEFAULT_LINEAR);       // Default grayscale
    
    Oled_SendCommand(SET_PRE_C_VOLTAGE);
    Oled_SendCommand(0x10);                     // Default - 0.5 x Vcc (RESET)

    // 11. VCOM
    Oled_SendCommand(SET_VCOM_VOLTAGE);         // SETVCOMVOLTAGE
    Oled_SendCommand(0x05);

    // 12. Second precharge period
    Oled_SendCommand(SET_COND_C_PERIOD);        // SETSECONDPRECHARGEPERIOD
    Oled_SendCommand(0x0A);

    // 13. Function selection B (så att RAM & display används normalt)
    Oled_SendCommand(FUNCTION_SELEC);           // FUNCTION SELECTION B
    Oled_SendCommand(0x62);

    // 14. Address window (128×128)
    Oled_SendCommand(SET_COLUMN_ADDRESS);       // SETCOLUMNADDRESS
    Oled_SendCommand(0x00);
    Oled_SendCommand(0x7F);

    Oled_SendCommand(SET_ROW_ADDRESS);          // SETROWADDRESS
    Oled_SendCommand(0x00);
    Oled_SendCommand(0x7F);                     // 0–127 = 128 rader

    // 15. Normal display mode
    Oled_SendCommand(NORMAL_MODE);              // NORMALDISPLAY

    // 16. Display ON
    Oled_SendCommand(DISPLAY_ON);               // DISPLAY ON
}

void Oled_DrawPixel(int16_t x, int16_t y, uint8_t color)
{
    if ((x < 0) || (x >= 128) || (y < 0) || (y >= 128) || color > 0x0F)
        return;


    uint8_t selectedCell = buffer[(y * (128 / 2)) + (x / 2)];

    if (x % 2)
    {
        // ojämn pixel -> låg nibble
        selectedCell = (selectedCell & 0xF0) | (color & 0x0F);
    }
    else
    {
        // jämn pixel -> hög nibble
        selectedCell = (selectedCell & 0x0F) | ((color & 0x0F) << 4);
    }

    buffer[(y * (128 / 2)) + (x / 2)] = selectedCell;
}

void Oled_Update(void)
{
    HAL_I2C_Mem_Write(&hi2c1, SSD1327_I2C_ADRESS, 0x40, I2C_MEMADD_SIZE_8BIT, buffer, 8192, 1000);
}

void Oled_Clear(uint8_t color)
{
    uint8_t byte = (color << 4) | (color & 0x0F); // fyll båda pixlar i varje byte
    memset(buffer, byte, sizeof(buffer));
}

void SSD1327_UpdateArea(uint8_t x0, uint8_t y0, uint8_t x1, uint8_t y1, uint8_t *data)
{
    // Column address: bytes, so divide by 2
    uint8_t colStart = x0 / 2;
    uint8_t colEnd   = x1 / 2;

    // Set column range
    Oled_SendCommand(0x15);
    Oled_SendCommand(colStart);
    Oled_SendCommand(colEnd);

    // Set row range
    Oled_SendCommand(0x75);
    Oled_SendCommand(y0);
    Oled_SendCommand(y1);

    // Number of bytes in each row of this region
    uint8_t bytesPerRow = ( (x1 - x0 + 1 + 1) / 2 ); // 21 pixlar → 11 bytes

    // Send full block
    for (uint8_t row = 0; row <= (y1 - y0); row++)
    {
        HAL_I2C_Mem_Write(&hi2c1,
                          SSD1327_I2C_ADRESS,
                          0x40,                     // Data
                          1,
                          &buffer[(y0 + row)*64 + colStart], // Row data in your buffer
                          bytesPerRow,
                          HAL_MAX_DELAY);
    }
}

void DrawSquare(int x_start, int y_start, int x_end, int y_end, uint8_t color)
{
    for(uint8_t i = x_start; i <= x_end; i++)
    {
        for(uint8_t j = y_start; j < y_end; j++)
        {
            Oled_DrawPixel(i, j, color);
        }
    }
}

void DrawLine(int x0, int y0, int x1, int y1, int color)
{
    int dx = abs(x1 - x0);
    int sx = x0 < x1 ? 1 : -1;
    int dy = -abs(y1 - y0);
    int sy = y0 < y1 ? 1 : -1;
    int err = dx + dy;  // error value

    while (1)
    {
        Oled_DrawPixel(x0, y0, color);

        if (x0 == x1 && y0 == y1)
            break;

        int e2 = 2 * err;
        if (e2 >= dy)
        {
            err += dy;
            x0 += sx;
        }
        if (e2 <= dx)
        {
            err += dx;
            y0 += sy;
        }
    }
}

void DrawCircle(int x0, int y0, int radius, int color)
{
    int x = radius;
    int y = 0;
    int err = 0;

    while (x >= y)
    {
        Oled_DrawPixel(x0 + x, y0 + y, color);
        Oled_DrawPixel(x0 + y, y0 + x, color);
        Oled_DrawPixel(x0 - y, y0 + x, color);
        Oled_DrawPixel(x0 - x, y0 + y, color);
        Oled_DrawPixel(x0 - x, y0 - y, color);
        Oled_DrawPixel(x0 - y, y0 - x, color);
        Oled_DrawPixel(x0 + y, y0 - x, color);
        Oled_DrawPixel(x0 + x, y0 - y, color);

        y += 1;
        if (err <= 0)
        {
            err += 2 * y + 1;
        }
        if (err > 0)
        {
            x -= 1;
            err -= 2 * x + 1;
        }
    }
}

void Oled_Draw1BitImage(int x0, int y0, const uint8_t *img, uint8_t w, uint8_t h, uint8_t color)
{
    uint8_t byteWidth = (w + 7) / 8; // antal byte per rad

    for(uint8_t y = 0; y < h; y++)
    {
        for(uint8_t x = 0; x < w; x++)
        {
            if(img[y * byteWidth + x / 8] & (128 >> (x % 8)))
            {
                Oled_DrawPixel(x0 + x, y0 + y, color); //Tänd
            }
        }
    }
}

void Oled_drawDigit(int x, int y, uint8_t digit, uint8_t color)
{
    if(digit > 99) return;

    uint8_t tens = digit / 10;
    uint8_t ones = digit % 10;

    DrawSquare(x, y, x + DIGIT_W*2 - 1, y + DIGIT_H - 1, 0x00);

    Oled_Draw1BitImage(x, y, digits[tens], DIGIT_W, DIGIT_H, color);
    Oled_Draw1BitImage(x + 18, y, digits[ones], DIGIT_W, DIGIT_H, color);
}

void UpdateClockDisplay(void)
{
    Oled_drawDigit(0, 100, (myGpsData.hour + 1), 0x0F);
    //Oled_drawColon(36, 108, 0x0F);
    Oled_drawDigit(45, 100, myGpsData.minute, 0x0F);
    //Oled_drawColon(88, 108, 0x0F);
    Oled_drawDigit(90, 100, myGpsData.second, 0x0F);

    SSD1327_UpdateArea(0, 100, 127, 127, NULL);
}

void Oled_drawColon(int x, int y, uint8_t color)
{
    Oled_DrawPixel(x, y+7, color);
    Oled_DrawPixel(x, y+11, color);
}

void Oled_introScreen(void)
{
    Oled_Clear(0x00);

    Oled_Draw1BitImage(0,0, Afry_logo, 128, 128, 0x0F);
    Oled_Update();
    HAL_Delay(2000);
    Oled_Clear(0x00);
    Oled_Draw1BitImage(0,0, KG_logo, 128, 128, 0x0F);
    Oled_Update();
    HAL_Delay(2000);

    Oled_Clear(0x00);

    Oled_Draw1BitImage(107,0, icon_gps_20x20, ICON_GPS_W, ICON_GPS_H, 0x05);
    Oled_Draw1BitImage(0,0, icon_bt_20x20, ICON_GPS_W, ICON_GPS_H, 0x05);

    Oled_Update();
}